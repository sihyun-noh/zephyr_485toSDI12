## app/esp32s3_4_0/Kconfig
```kconfig
mainmenu "Customized Menu Name"
source "Kconfig.zephyr"

menu "Application Options"
	config USR_FUN
		bool "Enable usr_fun"
		default n
		help
	  	Enables the usr_fun function.
	config NET_SAMPLE_APP_MAX_ITERATIONS
		int "Number of times to Publish sample MQTT messages"
		default 500
		help
	  	Send sample MQTT messages this many times in a MQTT connection
	  	before exiting. A value of zero means that the messages are sent
	  	forever.

	config NET_SAMPLE_APP_MAX_CONNECTIONS
		int "Number of times to connect to the MQTT server"
		default 0
		help
	  	Number of times to connect to the MQTT server. With each connection
	  	send NET_SAMPLE_APP_MAX_ITERATIONS amount of MQTT sample messages.
	  	A value of zero means to continue forever.


endmenu
```

## boards/agmo_ejection/agmo_ejection/Kconfig.agmo_ejection
```kconfig
# SPDX-License-Identifier: Apache-2.0

config BOARD_AGMO_EJECTION
	select SOC_STM32G473XX
```

## boards/agmo_ejection/agmo_ejection/board.yml
```yaml
board:
  name: agmo_ejection
  vendor: agmo_ejection
  socs:
    - name: stm32g473xx
```

## boards/agmo_tic/agmo_tic/Kconfig.agmo_tic
```kconfig
# Copyright (c) 2026
# SPDX-License-Identifier: Apache-2.0

config BOARD_AGMO_TIC
	select SOC_STM32G431XX
```

## boards/dajilog_tech/dajilog_tech/Kconfig.dajilog_tech
```kconfig
# Copyright (c) 2026
# SPDX-License-Identifier: Apache-2.0

config BOARD_DAJILOG_TECH
	select SOC_STM32G431XX
```

## boards/dajilog_tech/dajilog_tech/board.yml
```yaml
board:
  name: dajilog_tech
  vendor: dajilog_tech
  socs:
    - name: stm32g431xx
```

## components/Kconfig
```kconfig
# SPDX-License-Identifier: Apache-2.0

menu "Dajilog components"

rsource "ads1232/Kconfig"
rsource "display_oled/Kconfig"
rsource "rs485_modbus/Kconfig"
rsource "can_bus/Kconfig"
rsource "sbus/Kconfig"
rsource "sdi12_slave/Kconfig"
rsource "eeprom_store/Kconfig"
rsource "dajilog_device_profile/Kconfig"
rsource "dajilog_device_info/Kconfig"
rsource "dajilog_device_provisioning/Kconfig"

endmenu
```

## components/ads1232/Kconfig
```kconfig
# SPDX-License-Identifier: Apache-2.0

menuconfig DAJILOG_COMPONENT_ADS1232
	bool "ADS1232 loadcell ADC component"
	default y
	depends on GPIO
	help
	  Enable the ADS1232 GPIO bit-bang loadcell ADC component.

if DAJILOG_COMPONENT_ADS1232

config DAJILOG_ADS1232_READ_PERIOD_MS
	int "ADS1232 application read period in milliseconds"
	default 200

config DAJILOG_ADS1232_DRDY_TIMEOUT_MS
	int "ADS1232 DRDY wait timeout in milliseconds"
	default 150

config DAJILOG_ADS1232_SCLK_HALF_PERIOD_US
	int "ADS1232 SCLK half period in microseconds"
	default 2

config DAJILOG_ADS1232_STARTUP_DELAY_MS
	int "ADS1232 startup delay after power up"
	default 200

endif
```

## components/can_bus/Kconfig
```kconfig
# SPDX-License-Identifier: Apache-2.0

menuconfig DAJILOG_COMPONENT_CAN_BUS
	bool "CAN bus component"
	default y
	depends on CAN

if DAJILOG_COMPONENT_CAN_BUS

config DAJILOG_CAN_THREAD_STACK_SIZE
	int "CAN component thread stack size"
	default 2048

config DAJILOG_CAN_THREAD_PRIORITY
	int "CAN component thread priority"
	default 4

config DAJILOG_CAN_MSGQ_DEPTH
	int "CAN component message queue depth"
	default 4

config DAJILOG_CAN_RX_MSGQ_DEPTH
	int "CAN received frame queue depth"
	default 8
	help
	  Queue received frames for protocol services. Frames are dropped and
	  counted when this queue is full.

config DAJILOG_CAN_TX_TEST_ID
	hex "Default CAN test transmit ID"
	default 0x123

config DAJILOG_CAN_TX_PERIOD_MS
	int "Default CAN test transmit request period"
	default 1000

config DAJILOG_CAN_VERBOSE
	bool "Print every CAN event to the console"
	default y
	help
	  Enable verbose RX, TX and initialization messages. Disable this when
	  an interactive shell shares the console with the CAN component.

endif # DAJILOG_COMPONENT_CAN_BUS
```

## components/dajilog_device_info/Kconfig
```kconfig
# SPDX-License-Identifier: Apache-2.0

menuconfig DAJILOG_COMPONENT_DEVICE_INFO
	bool "Dajilog common device information component"
	default y
	depends on CAN
	depends on DAJILOG_COMPONENT_DEVICE_PROFILE
	help
	  Encode and validate the common Dajilog Device Info CAN protocol.
```

## components/dajilog_device_profile/Kconfig
```kconfig
# SPDX-License-Identifier: Apache-2.0

menuconfig DAJILOG_COMPONENT_DEVICE_PROFILE
	bool "Dajilog device profile component"
	default y
	depends on DAJILOG_COMPONENT_EEPROM_STORE
	select CRC
	help
	  Store and validate the device-specific network profile independently
	  from product calibration or measurement records.
```

## components/dajilog_device_provisioning/Kconfig
```kconfig
# SPDX-License-Identifier: Apache-2.0

menuconfig DAJILOG_COMPONENT_DEVICE_PROVISIONING
	bool "Dajilog USB shell provisioning component"
	default y
	depends on SHELL
	depends on DAJILOG_COMPONENT_DEVICE_INFO
	depends on DAJILOG_COMPONENT_DEVICE_PROFILE
	help
	  Provide the common device/profile/node-ID shell commands for local
	  commissioning over the configured Zephyr shell backend.
```

## components/display_oled/Kconfig
```kconfig
# SPDX-License-Identifier: Apache-2.0

menuconfig DAJILOG_COMPONENT_OLED_DISPLAY
	bool "SSD1309 OLED display component"
	default y
	depends on DISPLAY && CHARACTER_FRAMEBUFFER
	help
	  Enable the SSD1309/SSD1306-compatible OLED helper used by the
	  Dajilog bring-up application.

if DAJILOG_COMPONENT_OLED_DISPLAY

config DAJILOG_OLED_SCAN_I2C_ON_INIT
	bool "Scan I2C bus before OLED init"
	default y
	depends on I2C
	help
	  Print detected I2C slave addresses during display init. This is useful
	  during hardware bring-up and can be disabled later.

config DAJILOG_OLED_I2C_SPEED_HZ
	int "Documented OLED I2C bus speed"
	default 400000
	help
	  Informational value printed during bring-up. The real bus speed is set
	  in devicetree using clock-frequency.

config DAJILOG_OLED_SCAN_PERIOD_MS
	int "Periodic I2C scan interval in milliseconds"
	default 0
	help
	  Set to 0 to disable periodic scans. During hardware bring-up, use a
	  value such as 1000 to print the I2C scan result repeatedly.

endif # DAJILOG_COMPONENT_OLED_DISPLAY
```

## components/eeprom_store/Kconfig
```kconfig
# SPDX-License-Identifier: Apache-2.0

menuconfig DAJILOG_COMPONENT_EEPROM_STORE
	bool "AT24 EEPROM storage component"
	default y
	depends on EEPROM
	help
	  Enable the common EEPROM read/write component. Board devicetree must
	  provide an EEPROM node labelled eeprom0.

if DAJILOG_COMPONENT_EEPROM_STORE

config DAJILOG_EEPROM_BRINGUP_TEST
	bool "Run EEPROM read/write test at boot"
	default n
	help
	  Write a small test pattern to EEPROM and read it back once at boot.
	  Keep this disabled by default while USB CDC startup is being verified.

config DAJILOG_EEPROM_TEST_OFFSET
	hex "EEPROM test offset"
	default 0x0100
	depends on DAJILOG_EEPROM_BRINGUP_TEST
	help
	  Offset used by the one-shot EEPROM bring-up test. Keep it away from
	  the future application settings layout.

endif # DAJILOG_COMPONENT_EEPROM_STORE
```

## components/rs485_modbus/Kconfig
```kconfig
# SPDX-License-Identifier: Apache-2.0

menuconfig DAJILOG_COMPONENT_RS485_MODBUS
	bool "RS-485 Modbus RTU component"
	default y
	depends on UART_INTERRUPT_DRIVEN || SERIAL
	depends on GPIO
	help
	  Enable the RS-485 Modbus RTU helper used by the Dajilog bring-up
	  application.

if DAJILOG_COMPONENT_RS485_MODBUS

config DAJILOG_RS485_MODBUS_THREAD_STACK_SIZE
	int "RS-485 Modbus thread stack size"
	default 2048

config DAJILOG_RS485_MODBUS_THREAD_PRIORITY
	int "RS-485 Modbus thread priority"
	default 4

config DAJILOG_RS485_MODBUS_MSGQ_DEPTH
	int "RS-485 Modbus message queue depth"
	default 4

config DAJILOG_RS485_MODBUS_SENSOR_ADDR
	int "Default Modbus slave address"
	default 1
	range 1 247

config DAJILOG_RS485_MODBUS_START_REG
	int "Default Modbus input register start address"
	default 0
	range 0 65535

config DAJILOG_RS485_MODBUS_REG_COUNT
	int "Default Modbus input register count"
	default 2
	range 1 8

config DAJILOG_RS485_MODBUS_RESPONSE_TIMEOUT_MS
	int "Modbus response timeout in milliseconds"
	default 700

config DAJILOG_RS485_MODBUS_TX_TURNAROUND_US
	int "RS-485 TX-to-RX turnaround delay in microseconds"
	default 6000

config DAJILOG_RS485_MODBUS_POLL_PERIOD_MS
	int "Application poll request period in milliseconds"
	default 1000

endif # DAJILOG_COMPONENT_RS485_MODBUS
```

## components/sbus/Kconfig
```kconfig
# SPDX-License-Identifier: Apache-2.0

menuconfig DAJILOG_COMPONENT_SBUS
	bool "SBUS receiver component"
	default y
	depends on SERIAL

if DAJILOG_COMPONENT_SBUS

config DAJILOG_SBUS_THREAD_STACK_SIZE
	int "SBUS thread stack size"
	default 2048

config DAJILOG_SBUS_THREAD_PRIORITY
	int "SBUS thread priority"
	default 3

config DAJILOG_SBUS_LOG_PERIOD
	int "SBUS log every N frames"
	default 20

endif # DAJILOG_COMPONENT_SBUS
```

## components/sdi12_slave/Kconfig
```kconfig
# SPDX-License-Identifier: Apache-2.0

menuconfig DAJILOG_COMPONENT_SDI12_SLAVE
	bool "SDI-12 slave component"
	default y
	depends on GPIO

if DAJILOG_COMPONENT_SDI12_SLAVE

config DAJILOG_SDI12_THREAD_STACK_SIZE
	int "SDI-12 slave thread stack size"
	default 2048

config DAJILOG_SDI12_THREAD_PRIORITY
	int "SDI-12 slave thread priority"
	default 2

config DAJILOG_SDI12_MSGQ_DEPTH
	int "SDI-12 slave message queue depth"
	default 8

config DAJILOG_SDI12_RX_INVERTED
	bool "SDI-12 RX GPIO is inverted"
	default n

endif # DAJILOG_COMPONENT_SDI12_SLAVE
```

## dts/bindings/misc/agmo,ejection-io.yaml
```yaml
# SPDX-License-Identifier: Apache-2.0

description: GPIO map for the AGMO 12-channel ejection controller

compatible: "agmo,ejection-io"

properties:
  output-gpios:
    type: phandle-array
    required: true
    description: Twelve isolated ejection output control GPIOs in channel order.

  input-gpios:
    type: phandle-array
    required: true
    description: Fourteen isolated digital input GPIOs in channel order.

  manual-selector-input:
    type: int
    required: true
    description: Zero-based input index selecting manual mode.

  manual-button-count:
    type: int
    required: true
    description: Number of leading inputs mapped one-to-one to outputs in manual mode.

  encoder-a-gpios:
    type: phandle-array
    required: true

  encoder-b-gpios:
    type: phandle-array
    required: true

  encoder-switch-gpios:
    type: phandle-array
    required: true
```
